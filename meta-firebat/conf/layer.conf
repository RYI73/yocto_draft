## meta-firebat/conf/layer.conf
```bitbake
# We have a conf and classes directory, add to BBPATH
BBPATH .= ":${LAYERDIR}"
LAYERSERIES_COMPAT_firebat = "kirkstone"

# We have recipes-* directories, add to BBFILES
BBFILES += "${LAYERDIR}/recipes-*/*/*.bb \
            ${LAYERDIR}/recipes-*/*/*.bbappend"

BBFILE_COLLECTIONS += "firebat"
BBFILE_PATTERN_firebat = "^${LAYERDIR}/"
BBFILE_PRIORITY_firebat = "6"
```

## meta-mypackage/conf/layer.conf
```bitbake
# We have a conf and classes directory, add to BBPATH
BBPATH .= ":${LAYERDIR}"

# We have recipes-* directories, add to BBFILES
BBFILES += "${LAYERDIR}/recipes-*/*/*.bb \
            ${LAYERDIR}/recipes-*/*/*.bbappend"

BBFILE_COLLECTIONS += "meta-mypackage"
BBFILE_PATTERN_meta-mypackage = "^${LAYERDIR}/"
BBFILE_PRIORITY_meta-mypackage = "6"

LAYERDEPENDS_meta-mypackage = "core"
LAYERSERIES_COMPAT_meta-mypackage = "dunfell"
```

## meta-osd/conf/layer.conf
```bitbake
# We have a conf and classes directory, add to BBPATH
BBPATH .= ":${LAYERDIR}"

# We have recipes-* directories, add to BBFILES
BBFILES += "${LAYERDIR}/recipes/*/*.bb \
            ${LAYERDIR}/recipes/*/*.bbappend"

BBFILE_COLLECTIONS += "meta-osd"
BBFILE_PATTERN_meta-osd = "^${LAYERDIR}/"
BBFILE_PRIORITY_meta-osd = "6"

LAYERDEPENDS_meta-osd = "core"
LAYERSERIES_COMPAT_meta-osd = "dunfell"
```
